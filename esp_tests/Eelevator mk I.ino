#include "weights.h"

// Model dimensions
#define INPUT_SIZE 237
#define HIDDEN1_SIZE 128
#define HIDDEN2_SIZE 64
#define OUTPUT_SIZE 2

// Pin for the LED
#define LED_PIN 15 // Change this to your LED pin

// --- Test Sample ---
// Copy the 'combined' array of one sample from your Python print(combined[:9]) output
// Ensure it has exactly 237 values.
float test_sample[INPUT_SIZE] = { 0.05462825888098536 ,
0.24155949363200688 ,
0.7796610169491526 ,
0.06797122508538689 ,
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0.29193694683788757 ,
0.847457627118644};

// Buffers for layer outputs
float layer1_out[HIDDEN1_SIZE];
float layer2_out[HIDDEN2_SIZE];
float final_out[OUTPUT_SIZE];

void setup() {
  Serial.begin(115200);
  pinMode(LED_PIN, OUTPUT);
  delay(2000);

  Serial.println("Starting Inference Test...");
  
  // 1. Apply Standard Scaler
  for (int i = 0; i < INPUT_SIZE; i++) {
    test_sample[i] = (test_sample[i] - scaler_mean[i]) * scaler_scale[i];
  }

  // 2. Run Inference
  run_inference();

  // 3. Check Result
  int prediction = (final_out[1] > final_out[0]) ? 1 : 0;
  
  Serial.print("Output Logits: [");
  Serial.print(final_out[0]); Serial.print(", ");
  Serial.print(final_out[1]); Serial.println("]");
  
  if (prediction == 1) {
    Serial.println("Result: KEYWORD DETECTED!");
    digitalWrite(LED_PIN, HIGH);
  } else {
    Serial.println("Result: NOT KEYWORD");
    digitalWrite(LED_PIN, LOW);
  }
}

void loop() {
  // Nothing here for the static test
}

// Manual implementation of a Dense/Linear Layer + ReLU
void run_inference() {
  // Layer 1: Input (237) -> Hidden1 (128) + ReLU
  for (int i = 0; i < HIDDEN1_SIZE; i++) {
    float sum = network_0_bias[i];
    for (int j = 0; j < INPUT_SIZE; j++) {
      sum += test_sample[j] * network_0_weight[i * INPUT_SIZE + j];
    }
    layer1_out[i] = (sum > 0) ? sum : 0; // ReLU
  }

  // Layer 2: Hidden1 (128) -> Hidden2 (64) + ReLU
  for (int i = 0; i < HIDDEN2_SIZE; i++) {
    float sum = network_3_bias[i];
    for (int j = 0; j < HIDDEN1_SIZE; j++) {
      sum += layer1_out[j] * network_3_weight[i * HIDDEN1_SIZE + j];
    }
    layer2_out[i] = (sum > 0) ? sum : 0; // ReLU
  }

  // Layer 3: Hidden2 (64) -> Output (2) - No ReLU (logits)
  for (int i = 0; i < OUTPUT_SIZE; i++) {
    float sum = network_6_bias[i];
    for (int j = 0; j < HIDDEN2_SIZE; j++) {
      sum += layer2_out[j] * network_6_weight[i * HIDDEN2_SIZE + j];
    }
    final_out[i] = sum;
  }
}